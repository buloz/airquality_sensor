## main/Kconfig.projbuild
```kconfig
# put here your custom config value
menu "Ariqual Configuration"
    menu "WiFi"
        config ESP_WIFI_SSID
            string "WiFi SSID"
            default "Airqual-station"
            help
	        SSID (network name) for the example to connect to.

        config ESP_WIFI_PASSWORD
            string "WiFi Password"
            default "AardvarkBadgerHedgehog"
            help
            WiFi password (WPA or WPA2) for the example to use.        
    endmenu
    menu "I2C Master"
        config I2C_MASTER_SCL
            int "SCL GPIO Num"
            default 22
            help
                GPIO number for I2C Master clock line.

        config I2C_MASTER_SDA
            int "SDA GPIO Num"
            default 21
            help
                GPIO number for I2C Master data line.

        config I2C_MASTER_PORT_NUM
            int "Port Number"
            default 0
            help
                Port number for I2C Master device.

        config I2C_MASTER_FREQUENCY
            int "Master Frequency"
            default 100000
            help
                I2C Speed of Master device.
    endmenu
    menu "Airqual"
        config SENSOR_NAME
            string "Sensor name"
            default "airqualXX"
            help
                Name of the sensor.
        config STATION_IP
            string "Station IP"
            default "192.168.10.2"
            help
                IP address of the base station.
        config INFLUX_PORT
            string "InfluxDB port"
            default "8086"
            help
                Listening port for InfluxDB in the station.
        config INFLUX_TOKEN
            string "InfluxDB Authorization token"
            default "MyDefaultToken"
            help
                Token for POST authorization on InfluxDB.
        config WAKEUP_TIME_US
            int "Refresh time"
            default 600000000
            help 
                Wake up time in microseconds.
    endmenu
endmenu
```
